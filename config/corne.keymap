/* activate bluetooth */
#define CONFIG_WIRELESS 1

/* source keypos definitions */
#include "../zmk-nodefree-config/keypos_def/keypos_42keys.h"
#include "../zmk-nodefree-config/helper.h"

// aliases
#define TMUX_PREFIX &kp LC(SPACE)

/* map extra keys */
#define X_LT &kp LC(SPACE) 
// #define X_LT &tmux_ret_dance
#define X_LM &kp &trans
#define X_LB &kp LC(SPACE) 
#define X_RT &kp LC(LS(RET))
// #define X_RT &kp &ret_dance
#define X_RM &sk LALT
#define X_RB &kp LC(SPACE) 

#include "base.keymap"
// #include "swoop.keymap"
// #include "swoop_to_base.keymap"

